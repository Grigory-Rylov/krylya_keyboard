// krylya_keyboard.overlay

#include "krylya_keyboard.dtsi" // Notice that the main dtsi files are included in the overlay.

&kscan0 {
    col-gpios
            = <&gpio1 00 GPIO_ACTIVE_HIGH> // col0 from the schematic file
            , <&gpio0 24 GPIO_ACTIVE_HIGH> // col1 from the schematic file
            , <&gpio0 22 GPIO_ACTIVE_HIGH> // col2 from the schematic file
            , <&gpio0 20 GPIO_ACTIVE_HIGH> // col3 from the schematic file
            , <&gpio0 17 GPIO_ACTIVE_HIGH> // col4 from the schematic file


            , <&gpio0 11  GPIO_ACTIVE_HIGH> //col5 from the schematic file
            , <&gpio1 4  GPIO_ACTIVE_HIGH> //col6 from the schematic file
            , <&gpio1 6  GPIO_ACTIVE_HIGH> //col7 from the schematic file
            , <&gpio0 9  GPIO_ACTIVE_HIGH> //col8 from the schematic file
            , <&gpio0 10  GPIO_ACTIVE_HIGH> //col9 from the schematic file
            ;
};
